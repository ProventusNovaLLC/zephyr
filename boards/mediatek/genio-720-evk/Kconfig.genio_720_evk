## boards/mediatek/genio-720-evk/Kconfig.genio_720_evk
```kconfig
# Copyright 2025 MediaTek
# SPDX-License-Identifier: Apache-2.0

config BOARD_GENIO_720_EVK
	select SOC_MT8391_A55 if BOARD_GENIO_720_EVK_MT8391_A55
```

## boards/mediatek/genio-720-evk/board.yml
```yaml
board:
  name: genio_720_evk
  full_name: GENION 720 EVK (6*Cortex-A55 and 2*Cortex-A78)
  vendor: mediatek
  socs:
  - name: mt8391
```

## boards/mediatek/genio-720-evk/genio_720_evk_mt8391_a55_defconfig
```kconfig
#
# Copyright 2025 MediaTek
#
# SPDX-License-Identifier: Apache-2.0
#

# ARM Options
CONFIG_ARM64_VA_BITS_40=y
CONFIG_ARM64_PA_BITS_40=y

# Cache Options
CONFIG_CACHE_MANAGEMENT=y
CONFIG_DCACHE_LINE_SIZE_DETECT=y
CONFIG_ICACHE_LINE_SIZE_DETECT=y

# Enable GPIO
CONFIG_GPIO=y

# Serial Drivers
CONFIG_SERIAL=y
CONFIG_UART_INTERRUPT_DRIVEN=n
CONFIG_UART_USE_RUNTIME_CONFIGURE=y

# Enable Console
CONFIG_CONSOLE=y
CONFIG_CONSOLE_INPUT_MAX_LINE_LEN=256
CONFIG_CONSOLE_HANDLER=y
CONFIG_UART_CONSOLE=y

CONFIG_CLOCK_CONTROL=y

# Ensure the EINT interrupt driver is initialized early
CONFIG_INTC_INIT_PRIORITY=2
```

## drivers/gpio/Kconfig.mtk_gpio
```kconfig
# MediaTek GPIO configuration options
# Copyright (c) 2025, MediaTek
# SPDX-License-Identifier: Apache-2.0

config GPIO_MT8365
	bool "MediaTek MT8365 GPIO driver"
	default y
	depends on DT_HAS_MEDIATEK_MT8365_GPIO_ENABLED
	select PINCTRL
	help
	  Enable the MediaTek MT8365 GPIO driver.

config GPIO_MT8370
	bool "MediaTek MT8370 GPIO driver"
	default y
	depends on DT_HAS_MEDIATEK_MT8370_GPIO_ENABLED
	select PINCTRL
	help
	  Enable the MediaTek MT8370 GPIO driver.

config GPIO_MT8391
	bool "MediaTek MT8391 GPIO driver"
	default y
	depends on DT_HAS_MEDIATEK_MT8391_GPIO_ENABLED
	select PINCTRL
	help
	  Enable the MediaTek MT8391 GPIO driver.
```

## drivers/interrupt_controller/Kconfig.mtk_eint
```kconfig
# Copyright 2025 MediaTek
# SPDX-License-Identifier: Apache-2.0

config MTK_EINT_MT8365
	bool "MediaTek MT8365 EINT driver"
	default y
	depends on DT_HAS_MEDIATEK_MT8365_EINT_ENABLED
	help
	  Enable the MediaTek MT8365 EINT driver.

config MTK_EINT_MT8370
	bool "MediaTek MT8370 EINT driver"
	default y
	depends on DT_HAS_MEDIATEK_MT8370_EINT_ENABLED
	help
	  Enable the MediaTek MT8370 EINT driver.

config MTK_EINT_MT8391
	bool "MediaTek MT8391 EINT driver"
	default y
	depends on DT_HAS_MEDIATEK_MT8391_EINT_ENABLED
	help
	  Enable the MediaTek MT8391 EINT driver.
```

## drivers/pinctrl/Kconfig.mtk_pinctrl
```kconfig
# MediaTek PINCTRL
# Copyright (c) 2025, MediaTek
# SPDX-License-Identifier: Apache-2.0

config PINCTRL_MT8365
	bool "MediaTek MT8365 PINCTRL driver"
	default y
    depends on DT_HAS_MEDIATEK_MT8365_PINCTRL_ENABLED
	help
	  Enable the MediaTek MT8365 PINCTRL driver

config PINCTRL_MT8370
	bool "MediaTek MT8370 PINCTRL driver"
	default y
    depends on DT_HAS_MEDIATEK_MT8370_PINCTRL_ENABLED
	help
	  Enable the MediaTek MT8370 PINCTRL driver.

config PINCTRL_MT8391
	bool "MediaTek MT8391 PINCTRL driver"
	default y
    depends on DT_HAS_MEDIATEK_MT8391_PINCTRL_ENABLED
	help
	  Enable the MediaTek MT8391 PINCTRL driver.
```

## drivers/serial/Kconfig.mtk_uart
```kconfig
# MediaTek UART
# Copyright (c) 2025, MediaTek
# SPDX-License-Identifier: Apache-2.0

config UART_MT8365
	bool "MediaTek MT8365 UART driver"
	default y
	depends on DT_HAS_MEDIATEK_MT8365_UART_ENABLED
	select PINCTRL
	select SERIAL_HAS_DRIVER
	select SERIAL_SUPPORT_INTERRUPT
	help
	  Enable the MediaTek MT8365 UART driver.

config UART_MT8370
	bool "MediaTek MT8370 UART driver"
	default y
	depends on DT_HAS_MEDIATEK_MT8370_UART_ENABLED
	select PINCTRL
	select SERIAL_HAS_DRIVER
	select SERIAL_SUPPORT_INTERRUPT
	help
	  Enable the MediaTek MT8370 UART driver.

config UART_MT8391
	bool "MediaTek MT8391 UART driver"
	default y
	depends on DT_HAS_MEDIATEK_MT8391_UART_ENABLED
	select PINCTRL
	select SERIAL_HAS_DRIVER
	select SERIAL_SUPPORT_INTERRUPT
	help
	  Enable the MediaTek MT8391 UART driver.
```

## drivers/spi/Kconfig.mtk_spi
```kconfig
# Copyright (c) 2026 Proventus Nova
# SPDX-License-Identifier: Apache-2.0

config SPI_MT8391
	bool "MediaTek MT8391 SPI controller driver"
	default y
	depends on DT_HAS_MEDIATEK_MT8391_SPI_ENABLED
	select PINCTRL
	help
	  Enable the PIO/polling driver for the MediaTek MT8391 (Genio 720)
	  SPI controller (IPM generation IP, Linux reference spi-mt65xx.c).
	  Transfers are chunked through the 32-byte FIFO with completion
	  polled from the status register; no DMA and no interrupts are
	  used, which keeps the controller self-contained inside a
	  Jailhouse cell.
```

## dts/bindings/gpio/mediatek,mt8391-gpio.yaml
```yaml
# Copyright (c) 2025 MediaTek
# SPDX-License-Identifier: Apache-2.0

description: MT8391 GPIO

compatible: "mediatek,mt8391-gpio"

include: [gpio-controller.yaml, base.yaml]

properties:
  reg:
    required: true

  pinmux:
    type: phandles

  "#gpio-cells":
    const: 2

gpio-cells:
  - pin
  - flags
```

## dts/bindings/interrupt-controller/mediatek,mt8391-intc.yaml
```yaml
# Copyright 2025 MediaTek
# SPDX-License-Identifier: Apache-2.0

description: MediaTek MT8391 EINT interrupt controller

compatible: "mediatek,mt8391-eint"

include: [base.yaml]

properties:
  reg:
    required: true

  num-lines:
    type: int
    required: true
    description: Number of lines supported by the EINT interrupt controller.
```

## dts/bindings/pinctrl/mediatek,mt8391-pinctrl.yaml
```yaml
# Copyright (c) 2025 MediaTek
# SPDX-License-Identifier: Apache-2.0

description: MT8391 Pin Controller.

compatible: "mediatek,mt8391-pinctrl"

include: [base.yaml, pinctrl-device.yaml, pinctrl-device.yaml]

properties:
  reg:
    required: true

child-binding:
  child-binding:
    description: |
        MT8391 pins controller pin configuration states.

    include:
      - name: pincfg-node.yaml
        property-allowlist:
        - bias-disable
        - bias-pull-down
        - bias-pull-up
        - drive-push-pull
        - drive-open-drain
        - output-low
        - output-high

    properties:
      pinmux:
        required: true
        type: array
        description: Pinmux selection
```

## dts/bindings/serial/mediatek,mt8391-uart.yaml
```yaml
# Copyright 2025 MediaTek
# SPDX-License-Identifier: Apache-2.0

description: MT8391 UART

compatible: "mediatek,mt8391-uart"

include: [uart-controller.yaml, pinctrl-device.yaml]

properties:
  reg:
    required: true

  interrupts:
    required: false

  clock-frequency:
    required: true

  current-speed:
    description: |
      Initial baud rate setting for UART. Defaults to baudrate of 38400 if not specified.
    default: 57600

  stop-bits:
    description: |
      Sets the number of stop bits. Defaults to 1 if not specified.
    default: "1"

  data-bits:
    description: |
      Sets the number of data bits. Defaults to 8 if not specified.
    default: 8

  parity:
    description: |
      Sets the data parity. Defaults to none if not specified.
    default: "none"

  pinctrl-0:
    required: true

  pinctrl-names:
    required: true
```

## dts/bindings/spi/mediatek,mt8391-spi.yaml
```yaml
# Copyright (c) 2026 Proventus Nova
# SPDX-License-Identifier: Apache-2.0

description: MediaTek MT8391 SPI controller (IPM generation, PIO/polling operation)

compatible: "mediatek,mt8391-spi"

include: [spi-controller.yaml, pinctrl-device.yaml]

properties:
  reg:
    required: true

  interrupts:
    required: true

  clock-frequency:
    type: int
    required: true
    description: |
      SPI kernel (functional) clock rate in Hz as configured by the SoC
      clock tree. The SCK divider is derived from this rate.

  mediatek,pad-select:
    type: int
    default: 0
    description: PAD_SEL routing index for the controller pads.
```

## soc/mediatek/mt8391/a55/Kconfig
```kconfig
# Copyright 2025 MediaTek
# SPDX-License-Identifier: Apache-2.0

config SOC_MT8391_A55
	select ARM64
	select CPU_CORTEX_A55
	select ARM_ARCH_TIMER if SYS_CLOCK_EXISTS
	select SOC_PREP_HOOK

config MCUX_CORE_SUFFIX
	default "_ca55" if SOC_MT8391_A55
```

## soc/mediatek/mt8391/a55/Kconfig.soc
```kconfig
# Copyright 2025 MediaTek
# SPDX-License-Identifier: Apache-2.0

config SOC_SERIES_MT8391
	bool
	select SOC_FAMILY_MTK_GENIO

config SOC_SERIES
	default "mt8391" if SOC_SERIES_MT8391

config SOC_MT8391
	bool
	select SOC_SERIES_MT8391

config SOC_MT8391_A55
	bool
	select SOC_MT8391
	help
	  MTK MT8391 A55

config SOC_MT8391_A55
	bool
	select SOC_MT8391
	help
	  MTK MT8391 A55

config SOC
	default "mt8391" if SOC_MT8391

config SOC_PART_NUMBER_MT8391
	bool

config SOC_PART_NUMBER
	default "mt8391" if SOC_PART_NUMBER_MT8391
```
