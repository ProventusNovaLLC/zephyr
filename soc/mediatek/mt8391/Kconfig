## soc/mediatek/mt8391/Kconfig
```kconfig
# Copyright 2025 MediaTek
# SPDX-License-Identifier: Apache-2.0

if SOC_FAMILY_MTK_GENIO

# Source series Kconfig files first, so SOCs
# can override the defaults given here
rsource "*/Kconfig"

endif # SOC_FAMILY_MTK_GENIO
```

## soc/mediatek/mt8391/Kconfig.defconfig
```kconfig
# Copyright 2025 MediaTek
# SPDX-License-Identifier: Apache-2.0

if SOC_FAMILY_MTK_GENIO

# Source series Kconfig files first, so SoCs
# can override the defaults given here
rsource "*/Kconfig.defconfig"

endif # SOC_FAMILY_MTK_GENIO
```

## soc/mediatek/mt8391/Kconfig.soc
```kconfig
# Copyright 2025 MediaTek
# SPDX-License-Identifier: Apache-2.0

config SOC_FAMILY_MTK_GENIO
	bool

config SOC_FAMILY
	default "mtk-genio" if SOC_FAMILY_MTK_GENIO

rsource "*/Kconfig.soc"
```
